## meta-rcar-l3-offload/conf/layer.conf
```bitbake
# We have a conf and classes directory, add to BBPATH
BBPATH .= ":${LAYERDIR}"

# We have recipes-* directories, add to BBFILES
BBFILES += "${LAYERDIR}/recipes-*/*/*.bb \
	${LAYERDIR}/recipes-*/*/*.bbappend"

BBFILE_COLLECTIONS += "rswitch"
BBFILE_PATTERN_rswitch = "^${LAYERDIR}/"
BBFILE_PRIORITY_rswitch = "6"

LAYERSERIES_COMPAT_rswitch = "dunfell"
```

## meta-xt-domx-gen4/conf/layer.conf
```bitbake
# We have a conf and classes directory, add to BBPATH
BBPATH .= ":${LAYERDIR}"

# We have a packages directory, add to BBFILES
BBFILES += "${LAYERDIR}/recipes-*/*/*.bb \
            "

BBFILES_DYNAMIC += " \
virtualization-layer:${LAYERDIR}/recipes-extended/xen/*.bbappend \
rcar-gateway:${LAYERDIR}/recipes-bsp/optee*/*.bbappend \
"


BBFILE_COLLECTIONS += "xt-domx-gen4"
BBFILE_PATTERN_xt-domx-gen4 := "^${LAYERDIR}/"
BBFILE_PRIORITY_xt-domx-gen4 = "12"

LAYERSERIES_COMPAT_xt-domx-gen4 = "dunfell kirkstone"
```

## meta-xt-driver-domain-gen4/conf/layer.conf
```bitbake
# We have a conf and classes directory, add to BBPATH
BBPATH .= ":${LAYERDIR}"

# We have a packages directory, add to BBFILES
BBFILES += "${LAYERDIR}/recipes-*/*/*.bb \
            ${LAYERDIR}/recipes-*/*/*.bbappend"

BBFILE_COLLECTIONS += "xt-driver-domain-gen4"
BBFILE_PATTERN_xt-driver-domain-gen4 := "^${LAYERDIR}/"
BBFILE_PRIORITY_xt-driver-domain-gen4 = "12"

LAYERSERIES_COMPAT_xt-driver-domain-gen4 = "dunfell"
```

## meta-xt-rcar-bsp-gen4/conf/machine/spider.conf
```bitbake
#@TYPE: Machine
#@NAME: Spider machine
#@DESCRIPTION: Machine configuration for running Spider

SOC_FAMILY = "r8a779f0"

DEFAULTTUNE ?= "cortexa57-cortexa53"
require conf/machine/include/tune-cortexa57-cortexa53.inc

SOC_FAMILY =. "rcar-gen4:spider:"

require conf/machine/include/soc-family.inc

LINUXLIBCVERSION = "5.10%"

# 32BIT package install (default is disable)
# This variables can be used only in multilib.
USE_32BIT_PKGS ?= "0"
USE_32BIT_WAYLAND ?= "0"
USE_32BIT_MMP ?= "0"

MACHINE_FEATURES = ""

KERNEL_IMAGETYPE = "Image"
IMAGE_FSTYPES_append = " tar.bz2 ext4"

SERIAL_CONSOLES = "115200;ttySC0"

# Configuration for kernel
PREFERRED_PROVIDER_virtual/kernel = "linux-renesas"

# u-boot
PREFERRED_VERSION_u-boot = "v2020.10"
EXTRA_IMAGEDEPENDS += " u-boot"

# Add variable to Build Configuration in build log
BUILDCFG_VARS_append = " SOC_FAMILY"

# rsync is required to build kernel 5.4
HOSTTOOLS += "rsync"

# S4 u-boot configure
UBOOT_CONFIG ??= "spider"
UBOOT_CONFIG[spider] = "r8a779f0_spider_defconfig"

# Set Image & SDK name for S4
IMAGE_NAME = "${IMAGE_BASENAME}-s4${IMAGE_VERSION_SUFFIX}"
IMAGE_LINK_NAME = "${IMAGE_BASENAME}-s4"
SDK_NAME_r8a779f0 = "${DISTRO}-${TCLIBC}-${SDKMACHINE}-${IMAGE_BASENAME}-${TUNE_PKGARCH}-s4"
```
